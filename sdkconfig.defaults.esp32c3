## sdkconfig.defaults.esp32c3
```kconfig
# ====================================================
# ESP32-C3 默认SDK配置文件 (sdkconfig.defaults.esp32c3)
# 针对ESP32-C3开发板优化配置（无PSRAM）
# ====================================================

# Flash配置：16MB容量
CONFIG_ESPTOOLPY_FLASHSIZE_16MB=y
# 分区表文件：使用16MB专用分区表
CONFIG_PARTITION_TABLE_CUSTOM_FILENAME="partitions/v2/16m_c3.csv"

# ============ 语音唤醒词配置 ============
# 启用"你好小智"唤醒词（精简版，针对ESP32-C3优化）
CONFIG_SR_WN_WN9S_NIHAOXIAOZHI=y

# ============ WiFi和网络优化 ============
# WiFi静态接收缓冲区数量（减少内存占用）
CONFIG_ESP_WIFI_STATIC_RX_BUFFER_NUM=3
# WiFi动态接收缓冲区数量（平衡性能和内存）
CONFIG_ESP_WIFI_DYNAMIC_RX_BUFFER_NUM=6
# WiFi接收块确认窗口大小
CONFIG_ESP_WIFI_RX_BA_WIN=3
# TCP/IP接收邮箱大小
CONFIG_LWIP_TCPIP_RECVMBOX_SIZE=16
# 动态释放MbedTLS配置数据（优化内存使用）
CONFIG_MBEDTLS_DYNAMIC_FREE_CONFIG_DATA=y

# ============ 功能裁剪（节省Flash和RAM）============
# 禁用WPA3 SAE安全协议（减少代码体积）
CONFIG_ESP_WIFI_ENABLE_WPA3_SAE=n
# 禁用ESPNOW加密（减少代码体积）
CONFIG_ESP_WIFI_ESPNOW_MAX_ENCRYPT_NUM=0
# FreeRTOS空闲任务栈大小：768字节（节省RAM）
CONFIG_FREERTOS_IDLE_TASK_STACKSIZE=768
# 禁用IPv6支持（减少内存占用和代码体积）
CONFIG_LWIP_IPV6=n
```

## sdkconfig.defaults.esp32s3
```kconfig
# ====================================================
# ESP32-S3 默认SDK配置文件 (sdkconfig.defaults.esp32s3)
# 针对具有PSRAM的ESP32-S3开发板优化配置
# ====================================================

# Flash配置：16MB容量，QIO模式（四线SPI，提升速度）
CONFIG_ESPTOOLPY_FLASHSIZE_16MB=y
CONFIG_ESPTOOLPY_FLASHMODE_QIO=y

# CPU频率：设置为240MHz（ESP32-S3的最高频率）
CONFIG_ESP_DEFAULT_CPU_FREQ_MHZ_240=y

# ============ PSRAM（外部RAM）配置 ============
# 启用PSRAM支持
CONFIG_SPIRAM=y
# PSRAM模式：OCT（八线SPI，高速模式）
CONFIG_SPIRAM_MODE_OCT=y
# PSRAM时钟频率：80MHz
CONFIG_SPIRAM_SPEED_80M=y
# 当内存分配<=512字节时使用内部RAM（提升小内存分配性能）
CONFIG_SPIRAM_MALLOC_ALWAYSINTERNAL=512
# 为内部RAM预留64KB，确保关键数据在内部RAM中
CONFIG_SPIRAM_MALLOC_RESERVE_INTERNAL=65536
# 禁用PSRAM内存测试（加快启动速度）
CONFIG_SPIRAM_MEMTEST=n
# MbedTLS使用外部内存分配（将TLS缓冲区放在PSRAM中）
CONFIG_MBEDTLS_EXTERNAL_MEM_ALLOC=y

# ============ WiFi和网络优化 ============
# WiFi静态接收缓冲区数量（减少内存占用）
CONFIG_ESP_WIFI_STATIC_RX_BUFFER_NUM=3
# WiFi动态接收缓冲区数量（平衡性能和内存）
CONFIG_ESP_WIFI_DYNAMIC_RX_BUFFER_NUM=6
# WiFi接收块确认窗口大小
CONFIG_ESP_WIFI_RX_BA_WIN=3
# TCP/IP接收邮箱大小
CONFIG_LWIP_TCPIP_RECVMBOX_SIZE=16
# 动态释放MbedTLS配置数据（优化内存使用）
CONFIG_MBEDTLS_DYNAMIC_FREE_CONFIG_DATA=y

# ============ 缓存配置（ESP32-S3专用）============
# 指令缓存：32KB（ESP32-S3的默认配置）
CONFIG_ESP32S3_INSTRUCTION_CACHE_32KB=y
# 数据缓存行大小：64字节（优化内存访问）
CONFIG_ESP32S3_DATA_CACHE_LINE_64B=y

# ============ 语音唤醒词配置 ============
# 启用"你好小智"唤醒词的文本转语音(TTS)功能
CONFIG_SR_WN_WN9_NIHAOXIAOZHI_TTS=y

# ============ 系统配置 ============
# 系统事件任务栈大小：4KB（处理WiFi、IP等事件）
CONFIG_ESP_SYSTEM_EVENT_TASK_STACK_SIZE=4096

# ============ USB配置 ============
# USB主机控制传输最大大小：1.5KB（适用于USB设备通信）
CONFIG_USB_HOST_CONTROL_TRANSFER_MAX_SIZE=1536

# ============ LVGL图形库配置 ============
# 启用LVGL快照功能（用于截屏或界面保存）
CONFIG_LV_USE_SNAPSHOT=y
```
